## Config.in
```kconfig
source "$BR2_EXTERNAL_LOTLAB_PATH/package/droidsansfallback/Config.in"
source "$BR2_EXTERNAL_LOTLAB_PATH/package/rootfs_overlay/Config.in"
source "$BR2_EXTERNAL_LOTLAB_PATH/package/act_monitor/Config.in"
source "$BR2_EXTERNAL_LOTLAB_PATH/package/libwebsockets4/Config.in"
```

## board/lotlab/act_monitor/jxhmi_800480/uboot_defconfig
```kconfig
CONFIG_ARM=y
CONFIG_ARCH_SUNXI=y
CONFIG_SYS_TEXT_BASE=0x81700000
CONFIG_ENV_SIZE=0x8000
CONFIG_SPL=y
CONFIG_MACH_SUNIV=y
CONFIG_DRAM_CLK=156
CONFIG_DRAM_ZQ=0
CONFIG_SYS_CLK_FREQ=720000000
CONFIG_VIDEO_LCD_MODE="x:800,y:480,depth:18,pclk_khz:33000,le:87,ri:40,up:31,lo:13,hs:1,vs:1,sync:3,vmode:0"
CONFIG_VIDEO_LCD_BL_PWM="PE6"
# CONFIG_VIDEO_LCD_BL_PWM_ACTIVE_LOW is not set
CONFIG_VIDEO_LCD_SWAP_R_B=y
CONFIG_SPL_SPI_SUNXI=y
# CONFIG_DISTRO_DEFAULTS is not set
CONFIG_ENV_VARS_UBOOT_CONFIG=y
# CONFIG_FIT is not set
CONFIG_BOOTDELAY=0
CONFIG_USE_BOOTARGS=y
CONFIG_BOOTARGS="panic=5 rootwait root=/dev/mtdblock3 rw rootfstype=squashfs init=/sbin/mnt_overlay"
CONFIG_USE_BOOTCOMMAND=y
CONFIG_BOOTCOMMAND="sf probe 0 80000000; sf read 0x80c00000 0x3C000 0x4000; sf read 0x80008000 0x40000 0x240000; bootz 0x80008000 - 0x80c00000"
CONFIG_SYS_STDIO_DEREGISTER=y
# CONFIG_SPL_POWER_SUPPORT is not set
CONFIG_CMD_BOOTZ=y
# CONFIG_CMD_ELF is not set
# CONFIG_CMD_EXPORTENV is not set
# CONFIG_CMD_IMPORTENV is not set
# CONFIG_CMD_EDITENV is not set
# CONFIG_CMD_SAVEENV is not set
# CONFIG_CMD_ENV_EXISTS is not set
# CONFIG_CMD_FLASH is not set
# CONFIG_CMD_GPT is not set
CONFIG_CMD_SF=y
CONFIG_CMD_SPI=y
# CONFIG_CMD_ECHO is not set
# CONFIG_CMD_ITEST is not set
# CONFIG_CMD_SOURCE is not set
# CONFIG_CMD_SETEXPR is not set
# CONFIG_PARTITIONS is not set
CONFIG_DEFAULT_DEVICE_TREE="suniv-f1c100s-lotlab-act-monitor"
# CONFIG_NET is not set
CONFIG_HAVE_BLOCK_DEVICE=y
# CONFIG_INPUT is not set
# CONFIG_MMC is not set
CONFIG_DM_SPI_FLASH=y
CONFIG_SPI_FLASH=y
CONFIG_SPI_FLASH_WINBOND=y
CONFIG_TPL_DM_SERIAL=y
CONFIG_SPI=y
CONFIG_DM_SPI=y
CONFIG_SPI_SUNXI=y
# CONFIG_VIDEO_DT_SIMPLEFB is not set
# CONFIG_EFI_LOADER is not set
```

## configs/jxhmi_4_3_inch_defconfig
```kconfig
BR2_arm=y
BR2_KERNEL_MIRROR="https://mirror.bjtu.edu.cn/kernel"
BR2_CCACHE=y
BR2_GLOBAL_PATCH_DIR="$(BR2_EXTERNAL_LOTLAB_PATH)/patches"
BR2_PER_PACKAGE_DIRECTORIES=y
BR2_TOOLCHAIN_BUILDROOT_MUSL=y
BR2_KERNEL_HEADERS_5_4=y
BR2_TOOLCHAIN_BUILDROOT_CXX=y
BR2_GCC_ENABLE_LTO=y
BR2_ROOTFS_MERGED_USR=y
BR2_TARGET_GENERIC_ROOT_PASSWD="lotlab"
BR2_ROOTFS_OVERLAY="$(BR2_EXTERNAL_LOTLAB_PATH)/board/jxhmi/common/overlay"
BR2_ROOTFS_POST_BUILD_SCRIPT="$(BR2_EXTERNAL_LOTLAB_PATH)/board/jxhmi/common/post_build.sh"
BR2_ROOTFS_POST_IMAGE_SCRIPT="support/scripts/genimage.sh"
BR2_ROOTFS_POST_SCRIPT_ARGS="-c $(BR2_EXTERNAL_LOTLAB_PATH)/board/jxhmi/common/genimage_16M.cfg"
BR2_LINUX_KERNEL=y
BR2_LINUX_KERNEL_CUSTOM_GIT=y
BR2_LINUX_KERNEL_CUSTOM_REPO_URL="https://github.com/thirtythreeforty/linux"
BR2_LINUX_KERNEL_CUSTOM_REPO_VERSION="f1c100s-v5.2.4"
BR2_LINUX_KERNEL_USE_CUSTOM_CONFIG=y
BR2_LINUX_KERNEL_CUSTOM_CONFIG_FILE="$(BR2_EXTERNAL_LOTLAB_PATH)/board/jxhmi/common/linux_defconfig"
BR2_LINUX_KERNEL_DTS_SUPPORT=y
BR2_LINUX_KERNEL_CUSTOM_DTS_PATH="$(BR2_EXTERNAL_LOTLAB_PATH)/board/jxhmi/4.3_inch/dts/suniv-f1c100s-jxhmi-16m.dts"
BR2_PACKAGE_BUSYBOX_CONFIG="$(BR2_EXTERNAL_LOTLAB_PATH)/board/jxhmi/common/busybox.config"
BR2_PACKAGE_DEJAVU=y
BR2_PACKAGE_QT5=y
BR2_PACKAGE_QT5BASE_EXAMPLES=y
BR2_PACKAGE_QT5BASE_GUI=y
BR2_PACKAGE_QT5BASE_DEFAULT_QPA="linuxfb"
BR2_PACKAGE_QT5BASE_FONTCONFIG=y
BR2_PACKAGE_QT5BASE_HARFBUZZ=y
BR2_PACKAGE_QT5BASE_GIF=y
BR2_PACKAGE_QT5BASE_JPEG=y
BR2_PACKAGE_QT5BASE_PNG=y
BR2_PACKAGE_QT5BASE_TSLIB=y
BR2_PACKAGE_CAIRO=y
BR2_PACKAGE_CAIRO_PNG=y
BR2_PACKAGE_LIBDRM=y
BR2_PACKAGE_LIBDRM_INSTALL_TESTS=y
BR2_PACKAGE_LIBWEBSOCKETS=y
BR2_PACKAGE_DROPBEAR=y
BR2_TARGET_ROOTFS_SQUASHFS=y
BR2_TARGET_ROOTFS_SQUASHFS4_ZSTD=y
BR2_TARGET_UBOOT=y
BR2_TARGET_UBOOT_BUILD_SYSTEM_KCONFIG=y
BR2_TARGET_UBOOT_CUSTOM_GIT=y
BR2_TARGET_UBOOT_CUSTOM_REPO_URL="https://github.com/thirtythreeforty/u-boot"
BR2_TARGET_UBOOT_CUSTOM_REPO_VERSION="f1c100s-v2019.04"
BR2_TARGET_UBOOT_USE_CUSTOM_CONFIG=y
BR2_TARGET_UBOOT_CUSTOM_CONFIG_FILE="$(BR2_EXTERNAL_LOTLAB_PATH)/board/jxhmi/4.3_inch/uboot_defconfig"
BR2_TARGET_UBOOT_NEEDS_DTC=y
BR2_TARGET_UBOOT_NEEDS_PYLIBFDT=y
# BR2_TARGET_UBOOT_FORMAT_BIN is not set
BR2_TARGET_UBOOT_FORMAT_CUSTOM=y
BR2_TARGET_UBOOT_FORMAT_CUSTOM_NAME="u-boot-sunxi-with-spl.bin"
BR2_TARGET_UBOOT_CUSTOM_DTS_PATH="$(BR2_EXTERNAL_LOTLAB_PATH)/board/jxhmi/4.3_inch/dts/suniv-f1c100s-lotlab-act-monitor.dts"
```

## configs/lotlab_fam_defconfig
```kconfig
BR2_arm=y
BR2_CCACHE=y
BR2_GLOBAL_PATCH_DIR="$(BR2_EXTERNAL_LOTLAB_FAM_PATH)/patches"
BR2_PER_PACKAGE_DIRECTORIES=y
BR2_TOOLCHAIN_BUILDROOT_MUSL=y
BR2_KERNEL_HEADERS_5_4=y
BR2_ROOTFS_MERGED_USR=y
BR2_ROOTFS_OVERLAY="$(BR2_EXTERNAL_LOTLAB_FAM_PATH)/board/lotlab/act_monitor/overlay"
BR2_ROOTFS_POST_BUILD_SCRIPT="$(BR2_EXTERNAL_LOTLAB_FAM_PATH)/board/lotlab/act_monitor/post_build.sh"
BR2_ROOTFS_POST_IMAGE_SCRIPT="support/scripts/genimage.sh"
BR2_ROOTFS_POST_SCRIPT_ARGS="-c $(BR2_EXTERNAL_LOTLAB_FAM_PATH)/board/lotlab/act_monitor/genimage.cfg"
BR2_LINUX_KERNEL=y
BR2_LINUX_KERNEL_CUSTOM_GIT=y
BR2_LINUX_KERNEL_CUSTOM_REPO_URL="https://github.com/thirtythreeforty/linux"
BR2_LINUX_KERNEL_CUSTOM_REPO_VERSION="f1c100s-v5.2.4"
BR2_LINUX_KERNEL_USE_CUSTOM_CONFIG=y
BR2_LINUX_KERNEL_CUSTOM_CONFIG_FILE="$(BR2_EXTERNAL_LOTLAB_FAM_PATH)/board/lotlab/act_monitor/linux_defconfig"
BR2_LINUX_KERNEL_DTS_SUPPORT=y
BR2_LINUX_KERNEL_CUSTOM_DTS_PATH="$(BR2_EXTERNAL_LOTLAB_FAM_PATH)/board/lotlab/act_monitor/dts/suniv-f1c100s-lotact-monitor.dts"
BR2_PACKAGE_CAIRO=y
BR2_PACKAGE_CAIRO_PNG=y
BR2_PACKAGE_LIBDRM=y
BR2_PACKAGE_LIBDRM_INSTALL_TESTS=y
BR2_PACKAGE_LIBWEBSOCKETS=y
BR2_TARGET_ROOTFS_SQUASHFS=y
BR2_TARGET_ROOTFS_SQUASHFS4_ZSTD=y
BR2_TARGET_UBOOT=y
BR2_TARGET_UBOOT_BUILD_SYSTEM_KCONFIG=y
BR2_TARGET_UBOOT_CUSTOM_GIT=y
BR2_TARGET_UBOOT_CUSTOM_REPO_URL="https://github.com/thirtythreeforty/u-boot"
BR2_TARGET_UBOOT_CUSTOM_REPO_VERSION="f1c100s-v2019.04"
BR2_TARGET_UBOOT_USE_CUSTOM_CONFIG=y
BR2_TARGET_UBOOT_CUSTOM_CONFIG_FILE="$(BR2_EXTERNAL_LOTLAB_FAM_PATH)/board/lotlab/act_monitor/uboot_defconfig"
BR2_TARGET_UBOOT_NEEDS_DTC=y
BR2_TARGET_UBOOT_NEEDS_PYLIBFDT=y
# BR2_TARGET_UBOOT_FORMAT_BIN is not set
BR2_TARGET_UBOOT_FORMAT_CUSTOM=y
BR2_TARGET_UBOOT_FORMAT_CUSTOM_NAME="u-boot-sunxi-with-spl.bin"
BR2_TARGET_UBOOT_CUSTOM_DTS_PATH="$(BR2_EXTERNAL_LOTLAB_FAM_PATH)/board/lotlab/act_monitor/dts/suniv-f1c100s-lotlab-act-monitor.dts"
BR2_PACKAGE_HOST_MKPASSWD=y
```

## configs/lotlab_fam_jxhmi_defconfig
```kconfig
BR2_arm=y
BR2_ARM_INSTRUCTIONS_THUMB=y
BR2_KERNEL_MIRROR="https://mirror.bjtu.edu.cn/kernel"
BR2_CCACHE=y
BR2_GLOBAL_PATCH_DIR="$(BR2_EXTERNAL_LOTLAB_PATH)/patches"
BR2_PER_PACKAGE_DIRECTORIES=y
BR2_TOOLCHAIN_BUILDROOT_MUSL=y
BR2_KERNEL_HEADERS_5_4=y
BR2_GCC_ENABLE_LTO=y
BR2_ROOTFS_MERGED_USR=y
BR2_TARGET_GENERIC_ROOT_PASSWD="lotlab"
BR2_ROOTFS_OVERLAY="$(BR2_EXTERNAL_LOTLAB_PATH)/board/lotlab/common/overlay"
BR2_ROOTFS_POST_BUILD_SCRIPT="$(BR2_EXTERNAL_LOTLAB_PATH)/board/lotlab/common/post_build.sh"
BR2_ROOTFS_POST_IMAGE_SCRIPT="support/scripts/genimage.sh"
BR2_ROOTFS_POST_SCRIPT_ARGS="-c $(BR2_EXTERNAL_LOTLAB_PATH)/board/lotlab/common/genimage_16M.cfg"
BR2_LINUX_KERNEL=y
BR2_LINUX_KERNEL_CUSTOM_GIT=y
BR2_LINUX_KERNEL_CUSTOM_REPO_URL="https://github.com/thirtythreeforty/linux"
BR2_LINUX_KERNEL_CUSTOM_REPO_VERSION="f1c100s-v5.2.4"
BR2_LINUX_KERNEL_USE_CUSTOM_CONFIG=y
BR2_LINUX_KERNEL_CUSTOM_CONFIG_FILE="$(BR2_EXTERNAL_LOTLAB_PATH)/board/lotlab/act_monitor/linux_defconfig"
BR2_LINUX_KERNEL_DTS_SUPPORT=y
BR2_LINUX_KERNEL_CUSTOM_DTS_PATH="$(BR2_EXTERNAL_LOTLAB_PATH)/board/lotlab/act_monitor/jxhmi_800480/dts/suniv-f1c100s-lotact-monitor-16m.dts"
BR2_PACKAGE_BUSYBOX_CONFIG="$(BR2_EXTERNAL_LOTLAB_PATH)/board/lotlab/common/busybox.config"
BR2_PACKAGE_CAIRO=y
BR2_PACKAGE_CAIRO_PNG=y
BR2_PACKAGE_LIBDRM=y
BR2_PACKAGE_LIBDRM_INSTALL_TESTS=y
BR2_PACKAGE_LIBWEBSOCKETS=y
BR2_PACKAGE_DROPBEAR=y
BR2_TARGET_ROOTFS_SQUASHFS=y
BR2_TARGET_ROOTFS_SQUASHFS4_ZSTD=y
BR2_TARGET_UBOOT=y
BR2_TARGET_UBOOT_BUILD_SYSTEM_KCONFIG=y
BR2_TARGET_UBOOT_CUSTOM_GIT=y
BR2_TARGET_UBOOT_CUSTOM_REPO_URL="https://github.com/thirtythreeforty/u-boot"
BR2_TARGET_UBOOT_CUSTOM_REPO_VERSION="f1c100s-v2019.04"
BR2_TARGET_UBOOT_USE_CUSTOM_CONFIG=y
BR2_TARGET_UBOOT_CUSTOM_CONFIG_FILE="$(BR2_EXTERNAL_LOTLAB_PATH)/board/lotlab/act_monitor/jxhmi_800480/uboot_defconfig"
BR2_TARGET_UBOOT_NEEDS_DTC=y
BR2_TARGET_UBOOT_NEEDS_PYLIBFDT=y
# BR2_TARGET_UBOOT_FORMAT_BIN is not set
BR2_TARGET_UBOOT_FORMAT_CUSTOM=y
BR2_TARGET_UBOOT_FORMAT_CUSTOM_NAME="u-boot-sunxi-with-spl.bin"
BR2_TARGET_UBOOT_CUSTOM_DTS_PATH="$(BR2_EXTERNAL_LOTLAB_PATH)/board/lotlab/act_monitor/jxhmi_800480/dts/suniv-f1c100s-lotlab-act-monitor.dts"
BR2_PACKAGE_HOST_GENIMAGE=y
BR2_PACKAGE_HOST_MTD=y
```

## package/act_monitor/Config.in
```kconfig
config BR2_PACKAGE_ACT_MONITOR
    bool "FFXIV Act Monitor"
    help 
        Add FFXIV Act Monitor
    select BR2_PACKAGE_DROIDSANSFALLBACK
    select BR2_PACKAGE_CAIRO
    select BR2_PACKAGE_LIBDRM
    select BR2_PACKAGE_LIBWEBSOCKETS4
    select BR2_PACKAGE_JANSSON
```

## package/droidsansfallback/Config.in
```kconfig
config BR2_PACKAGE_DROIDSANSFALLBACK
    bool "DroidSansFallback"
    help 
        Add DroidSansFallback font
```

## package/rootfs_overlay/Config.in
```kconfig
config BR2_PACKAGE_ROOTFS_OVERLAY
    bool "RootFS Overlay"
    help 
        Enable overlayfs on rootfs
```
